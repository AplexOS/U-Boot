## board/cmi_at751/Kconfig
```kconfig
if TARGET_AM335X_CMI_AT751

config SYS_BOARD
	default "cmi_at751"

config SYS_SOC
	default "am33xx"

config SYS_CONFIG_NAME
	default "am335x_cmi_at751"

config CONS_INDEX
	int "UART used for console"
	range 1 6
	default 1
	help
	  The AM335x SoC has a total of 6 UARTs (UART0 to UART5 as referenced
	  in documentation, etc) available to it.  Depending on your specific
	  board you may want something other than UART0.

endif
```

## board/ecm_5410/Kconfig
```kconfig
if TARGET_AM335X_ECM_5410

config SYS_BOARD
	default "ecm_5410"

config SYS_SOC
	default "am33xx"

config SYS_CONFIG_NAME
	default "am335x_ecm_5410"

config CONS_INDEX
	int "UART used for console"
	range 1 6
	default 1
	help
	  The AM335x SoC has a total of 6 UARTs (UART0 to UART5 as referenced
	  in documentation, etc) available to it.  Depending on your specific
	  board you may want something other than UART0.

endif
```
